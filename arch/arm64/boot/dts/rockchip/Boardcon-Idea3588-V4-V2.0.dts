// SPDX-License-Identifier: (GPL-2.0+ OR MIT)
/*
 * Copyright (c) 2023 Rockchip Electronics Co., Ltd.
 *
 */

/dts-v1/;

#include "Boardcon-Idea3588-V4-V2.0.dtsi"
#include "rk3588-linux.dtsi"
#include "Boardcon-imx415-dphy0.dtsi"  // camera0
#include "Boardcon-imx415-dphy1.dtsi"   // camera1
//#include "Boardcon-imx415-dcphy1.dtsi"  // camera2


/ {
	model = "Rockchip RK3588 EVB7 V11 Board";
	compatible = "rockchip,rk3588-evb7-v11", "rockchip,rk3588";
};
