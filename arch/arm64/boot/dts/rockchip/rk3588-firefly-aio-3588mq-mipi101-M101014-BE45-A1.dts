// SPDX-License-Identifier: (GPL-2.0+ OR MIT)
/*
 * Copyright (c) 2021 Rockchip Electronics Co., Ltd.
 *
 */
/dts-v1/;
#include "rk3588-firefly-aio-3588q.dtsi"
#include "rk3588-firefly-aio-cam-8ms1m.dtsi"
#include "rk3588-firefly-demo.dtsi"
#define WHICHDSI 0 /* dsi0 = 0,dsi1 = 1*/
#include "rk3588m.dtsi"   //rk3588m and rk3588j use,if rk3588 close this include
#include "rk3588-firefly-aio-3588q-mipi101-M101014-BE45-A1.dtsi"
/ {
	model = "Firefly AIO-3588MQ MIPI101(Linux)";
	compatible = "rockchip,rk3588-firefly-aio-3588q-mipi101-M101014-BE45-A1", "rockchip,rk3588";
};